## panels/feeding_control/firmware/main/Kconfig.projbuild
```kconfig
menu "Thread Panel — feeding_control"

    config MQTT_BROKER_URI
        string "MQTT broker URI"
        default "mqtts://homeassistant.local:8883"
        help
            URI of the MQTT broker. Use mqtts:// for TLS.

    # MQTT username + password are NOT Kconfig options. They live in NVS
    # (namespace "panel_mqtt", keys "user" / "pass") and are populated at
    # provisioning time by the bridge sending a panel_set_creds UART
    # envelope. install-pi.sh prompts for the values and writes them to
    # /opt/panel/mqtt_creds.json on the Pi; the bridge reads that file and
    # forwards over UART. See platform/firmware/components/panel_platform/
    # panel_net.c (panel_net_set_credentials) for the C6 side.
    #
    # Reason for the indirection: published firmware.bin artifacts must
    # carry no credentials. Anything in Kconfig becomes a string literal
    # in the binary, so MQTT auth can't go through this menu.

    config MQTT_CLIENT_ID
        string "MQTT client ID"
        default "thread_panel_feeding_control"
        help
            Client ID the C6 uses when connecting to the broker.

endmenu
```

## panels/feeding_control/firmware/sdkconfig.defaults
```kconfig
#
# Serial Flasher Config
#
# The XIAO ESP32-C6 has 4 MB of flash; ESP-IDF's default for esp32c6 is
# 2 MB, so we have to set this explicitly. The OTA partition layout needs
# two ~1.875 MB app slots plus overhead, which requires the full 4 MB.
# CONFIG_ESPTOOLPY_FLASHSIZE_2MB is not set
CONFIG_ESPTOOLPY_FLASHSIZE_4MB=y
CONFIG_ESPTOOLPY_FLASHSIZE="4MB"
# end of Serial Flasher Config

#
# Partition Table
#
CONFIG_PARTITION_TABLE_CUSTOM=y
CONFIG_PARTITION_TABLE_CUSTOM_FILENAME="partitions.csv"
CONFIG_PARTITION_TABLE_FILENAME="partitions.csv"
CONFIG_PARTITION_TABLE_OFFSET=0x8000
CONFIG_PARTITION_TABLE_MD5=y
# end of Partition Table

#
# OTA rollback
#
# With rollback enabled, a freshly-OTA'd app must call
# esp_ota_mark_app_valid_cancel_rollback() to commit itself. If it
# crashes or stalls before doing so, the bootloader reverts to the
# previous partition on the next reset. We mark valid in panel_net.c
# after MQTT reaches the broker — that's a decent proxy for "all the
# layered infrastructure still works."
CONFIG_BOOTLOADER_APP_ROLLBACK_ENABLE=y
# end of OTA rollback

#
# mbedTLS
#
CONFIG_MBEDTLS_CMAC_C=y
CONFIG_MBEDTLS_SSL_PROTO_DTLS=y
CONFIG_MBEDTLS_KEY_EXCHANGE_ECJPAKE=y
CONFIG_MBEDTLS_ECJPAKE_C=y
# end of mbedTLS

#
# OpenThread
#
CONFIG_OPENTHREAD_ENABLED=y
CONFIG_OPENTHREAD_BORDER_ROUTER=n
CONFIG_OPENTHREAD_DNS64_CLIENT=y
CONFIG_OPENTHREAD_TASK_SIZE=10240
CONFIG_OPENTHREAD_CONSOLE_ENABLE=n
# Device type: MTD (Minimal Thread Device / child). The C6 is a mains-
# powered leaf — it doesn't need to route for anyone. FTD (the ESP-IDF
# default) causes the C6 to promote to router and maintain links to every
# neighboring router, which destabilizes the mesh under retained-message
# bursts. MTD picks one parent and sticks with it.
# CONFIG_OPENTHREAD_FTD is not set
CONFIG_OPENTHREAD_MTD=y
# end of OpenThread

#
# lwIP
#
CONFIG_LWIP_TCPIP_TASK_STACK_SIZE=4096
CONFIG_LWIP_IPV6_NUM_ADDRESSES=8
CONFIG_LWIP_MULTICAST_PING=y
CONFIG_LWIP_HOOK_IP6_SELECT_SRC_ADDR_CUSTOM=y
# end of lwIP

#
# ESP System Settings
#
CONFIG_ESP_MAIN_TASK_STACK_SIZE=6144
# end of ESP System Settings
```
